## CMakeLists.txt
```
cmake_minimum_required(VERSION 3.20.0)
find_package(Zephyr REQUIRED HINTS $ENV{ZEPHYR_BASE})
project(L073RZ C CXX)
set(CMAKE_CXX_STANDARD 20)
set(CMAKE_CXX_STANDARD_REQUIRED ON)
set(CMAKE_CXX_EXTENSIONS OFF)

include_directories(inc)

target_link_libraries(app PRIVATE stdc++)

target_sources(app PRIVATE 
    src/main.cpp 
    src/gpio.cpp 
    src/threads.cpp
)
target_compile_options(app PRIVATE
    $<$<COMPILE_LANGUAGE:CXX>:-fpermissive>
)
```

## prj.conf
```kconfig
# CONFIG_GPIO=y
# CONFIG_SERIAL=y
# CONFIG_CONSOLE=y
# CONFIG_UART_CONSOLE=y
# CONFIG_DEBUG=y
# CONFIG_PM=n
# CONFIG_NO_OPTIMIZATIONS=y
# CONFIG_PRINTK=y
# CONFIG_CPP=y
# CONFIG_REQUIRES_FULL_LIBCPP=y
# CONFIG_MULTITHREADING=y
# CONFIG_LOG=y
# CONFIG_THREAD_STACK_INFO=y
# CONFIG_THREAD_MONITOR=y
# CONFIG_INIT_STACKS=y
# CONFIG_THREAD_NAME=y
# CONFIG_LOG_MODE_DEFERRED=y


CONFIG_GPIO=y
CONFIG_PRINTK=y
CONFIG_LOG=y
CONFIG_THREAD_NAME=y
CONFIG_THREAD_STACK_INFO=y
CONFIG_THREAD_MONITOR=y
CONFIG_CPP=y
CONFIG_REQUIRES_FULL_LIBCPP=y
# CONFIG_LOG_DEFAULT_LEVEL=4
```

## src/main.c
```c
#include <zephyr/kernel.h>
#include <zephyr/device.h>
#include <zephyr/drivers/gpio.h>
#include <zephyr/logging/log.h>

LOG_MODULE_REGISTER(main);

#define LED0_NODE DT_ALIAS(led0)
#define SW0_NODE DT_ALIAS(sw0)


#define STACK_SIZE 512
#define PRIORITY 5

K_MSGQ_DEFINE(button_msgq, sizeof(bool), 10, 4);

static const struct gpio_dt_spec button = GPIO_DT_SPEC_GET(SW0_NODE, gpios);
static const struct gpio_dt_spec led = GPIO_DT_SPEC_GET(LED0_NODE, gpios);
static struct gpio_callback button_cb_data;
static struct k_work_delayable debounce_work;

void debounce_work_handler(struct k_work *work)
{
    gpio_pin_interrupt_configure_dt(&button, GPIO_INT_EDGE_TO_ACTIVE);
}

void button_callback(const struct device *dev, struct gpio_callback *cb, uint32_t pins)
{
    gpio_pin_interrupt_configure_dt(&button, GPIO_INT_DISABLE);
    
    static bool pressed = 1;
    
    pressed = pressed ^ 1;

    LOG_INF(">>button_callback: pressed state: %d", pressed);
    if (k_msgq_put(&button_msgq, &pressed, K_NO_WAIT) != 0) {
        LOG_WRN("Kolejka komunikatów jest pełna!");
    }
    k_work_schedule(&debounce_work, K_MSEC(100));               // opóźnione ponowne włączenie
    
}

// Wątek do migania LED
void led_thread(void *arg1, void *arg2, void *arg3)
{
    bool button_is_pressed;
    int ret = gpio_pin_configure_dt(&led, GPIO_OUTPUT_ACTIVE);
    if (ret < 0) {
        LOG_ERR("Nie udało się skonfigurować LED");
        return;
    }

    while (1) {
        k_msgq_get(&button_msgq, &button_is_pressed, K_FOREVER);
         if (button_is_pressed) {
            LOG_INF("Przycisk wciśnięty -> Włączam LED");
            gpio_pin_set_dt(&led, 1); // Włącz LED
        } else {
            LOG_INF("Przycisk puszczony -> Wyłączam LED");
            gpio_pin_set_dt(&led, 0); // Wyłącz LED
        }
        // gpio_pin_toggle_dt(&led);
        // LOG_INF("LED");
        // k_sleep(K_SECONDS(1));
    }
}

// Wątek do logowania
void logger_thread(void *arg1, void *arg2, void *arg3)
{
    while (1) {
        LOG_INF("Działa drugi wątek logujący");
        k_sleep(K_SECONDS(2));
    }
}

// Stosy i definicje wątków
K_THREAD_STACK_DEFINE(led_stack, STACK_SIZE);
K_THREAD_STACK_DEFINE(log_stack, STACK_SIZE);

static struct k_thread led_thread_data;
static struct k_thread log_thread_data;

void main(void)
{
    // Konfiguracja przycisku z przerwaniem
    gpio_pin_configure_dt(&button, GPIO_INPUT);
    gpio_pin_interrupt_configure_dt(&button, GPIO_INT_EDGE_TO_ACTIVE); // reaguj na wciśnięcie i puszczenie

    gpio_init_callback(&button_cb_data, button_callback, BIT(button.pin));
    gpio_add_callback(button.port, &button_cb_data);

    k_work_init_delayable(&debounce_work, debounce_work_handler);

    k_thread_create(&led_thread_data, led_stack, STACK_SIZE,
                    led_thread, NULL, NULL, NULL,
                    PRIORITY, 0, K_NO_WAIT);

    k_thread_create(&log_thread_data, log_stack, STACK_SIZE,
                    logger_thread, NULL, NULL, NULL,
                    PRIORITY, 0, K_NO_WAIT);

    LOG_INF("Wątki zostały uruchomione");
}
```

## src/main.cpp
```c
#include <zephyr/kernel.h>
#include <zephyr/device.h>
#include <zephyr/drivers/gpio.h>
#include <zephyr/logging/log.h>
#include <string>
#include "main.hpp"
#include "gpio.hpp"
#include "threads.hpp"

LOG_MODULE_REGISTER(main, LOG_LEVEL_DBG);

int main(void)
{
    gpio::GPIO gpio(os::callback);
    os::Thread threads(gpio);
    threads.createLogThread();
    threads.createLedThread();

    LOG_INF("Threads are run");

    return 0;
}
```

## inc/gpio.hpp
```c
#pragma once

#include <zephyr/drivers/gpio.h>
#include <zephyr/logging/log.h>
#include <functional>

namespace gpio
{
    
    void isr(const struct device *dev, struct gpio_callback *cb, uint32_t pins);

    class GPIO
    {
        public:
            GPIO();
            GPIO(gpio_callback_handler_t isr_handler);
            GPIO* getAddress();
            void setLed(bool state);
    };
};
```

## inc/swIrq.hpp
```c
#pragma once

namespace appSw
{
    class SW
    {
        public:
            void debounce_work_handler([[maybe_unused]]struct k_work *work)
            void button_callback([[maybe_unused]]const struct device *dev, [[maybe_unused]]struct gpio_callback *cb, [[maybe_unused]]uint32_t pins);
        private:
            struct k_work_delayable debounce_work;
    };
}
```

## inc/threadLed.hpp
```c
#pragma once 

void ledThreadInit(void);
```

## inc/threads.hpp
```c
#pragma once 
#include <zephyr/kernel.h>
#include <zephyr/device.h>
#include <zephyr/logging/log.h>
#include <string>
#include "main.hpp"
#include "gpio.hpp"

#define STACK_SIZE 512
#define PRIORITY 5

namespace os
{
    
    void callback(const struct device *dev, struct gpio_callback *cb, uint32_t pins);
    void led_thread(void *arg1, void *arg2, void *arg3);
    void logger_thread(void *arg1, void *arg2, void *arg3);
    
    class Thread
    {
        public:
            Thread(gpio::GPIO &instance);
            
            void createLedThread();
            void createLogThread();

            // struct k_thread led_thread_data;
            // struct k_thread log_thread_data;
            gpio::GPIO &gpioInstance;
    };
}
```

## src/gpio.cpp
```c
#include <zephyr/drivers/gpio.h>
#include <zephyr/logging/log.h>
#include "gpio.hpp"

LOG_MODULE_DECLARE(main);

#define SW0_NODE DT_ALIAS(sw0)
#define LED0_NODE DT_ALIAS(led0)

struct gpio_dt_spec button = GPIO_DT_SPEC_GET(SW0_NODE, gpios);
struct gpio_callback button_cb_data;
struct gpio_dt_spec led = GPIO_DT_SPEC_GET(LED0_NODE, gpios);


namespace gpio {

void isr(const struct device *dev, struct gpio_callback *cb, uint32_t pins)
{
    LOG_INF("Button ISR");
}

GPIO::GPIO()
{
    GPIO::GPIO(isr);
}

GPIO::GPIO(gpio_callback_handler_t isr_handler)
{
    gpio_pin_configure_dt(&led, GPIO_OUTPUT_ACTIVE);

    gpio_pin_configure_dt(&button, GPIO_INPUT);
    gpio_pin_interrupt_configure_dt(&button, GPIO_INT_EDGE_TO_ACTIVE);

    gpio_init_callback(&button_cb_data, isr_handler, BIT(button.pin));
    gpio_add_callback(button.port, &button_cb_data);
}

GPIO* GPIO::getAddress()
{
    return this;
}

void GPIO::setLed(bool state)
{
    gpio_pin_set_dt(&led, state);
}
}
```

## src/swIrq.cpp
```c
#include "swIrq.hpp"

using namespace appSw;

void SW::debounce_work_handler([[maybe_unused]]struct k_work *work)
{
    gpio_pin_interrupt_configure_dt(&button, GPIO_INT_EDGE_TO_ACTIVE);
}

void SW::button_callback([[maybe_unused]]const struct device *dev, [[maybe_unused]]struct gpio_callback *cb, [[maybe_unused]]uint32_t pins)
{
    gpio_pin_interrupt_configure_dt(&button, GPIO_INT_DISABLE);
    
    static bool pressed = 1;
    
    pressed = pressed ^ 1;

    // LOG_INF(">>button_callback: pressed state: %d", pressed);
    if (k_msgq_put(&button_msgq, &pressed, K_NO_WAIT) != 0) {
        LOG_WRN("Kolejka komunikatów jest pełna!");
    }
    k_work_schedule(&debounce_work, K_MSEC(100));               // opóźnione ponowne włączenie
    
}
```

## src/threadLed.cpp
```c
#include <zephyr/drivers/gpio.h>
#include <zephyr/logging/log.h>
#include "threadLed.hpp"



void ledThreadInit(void)
{
    
}
```

## src/threads.cpp
```c
#include "threads.hpp"
#include <zephyr/logging/log.h>

LOG_MODULE_DECLARE(main);

namespace os
{
struct k_thread led_thread_data;
struct k_thread log_thread_data;
    
K_THREAD_STACK_DEFINE(led_stack, STACK_SIZE);
K_THREAD_STACK_DEFINE(log_stack, STACK_SIZE);

K_MSGQ_DEFINE(button_msgq, sizeof(bool), 10, 4);
    
void callback(const struct device *dev, struct gpio_callback *cb, uint32_t pins)
{
    static bool pressed = false;
    
    pressed = !pressed;
    
    if (k_msgq_put(&button_msgq, &pressed, K_NO_WAIT) != 0) {
        LOG_WRN("Queue is full");
    }
}

Thread::Thread(gpio::GPIO &instance):gpioInstance(instance){
}

void led_thread(void *arg1, void *arg2, void *arg3)
{
    LOG_INF("led_thread start");
    bool button_is_pressed;
    gpio::GPIO *gc = (gpio::GPIO*)arg1;
    std::string text;

    while (1) {
        k_msgq_get(&button_msgq, &button_is_pressed, K_FOREVER);
        gc->setLed(button_is_pressed);
        text.clear();
        button_is_pressed == true ? text.append("Sw is pressed and LED turn ON") : text.append("Switch is pushed and LED turn OFF");
        LOG_INF("%s", text.c_str());
    }
}

void logger_thread(void *arg1, void *arg2, void *arg3)
{
    LOG_INF("logger_thread start");
    while (1) {
        LOG_INF("Secound thread is working");
        k_sleep(K_SECONDS(2));
    }
}

void Thread::createLedThread()
{
    k_thread_create(&led_thread_data, led_stack, STACK_SIZE,
                led_thread, gpioInstance.getAddress(), NULL, NULL,
                PRIORITY, 0, K_NO_WAIT);
}

void Thread::createLogThread()
{
    k_thread_create(&log_thread_data, log_stack, STACK_SIZE,
                logger_thread, NULL, NULL, NULL,
                PRIORITY, 0, K_NO_WAIT);
}

}
```
